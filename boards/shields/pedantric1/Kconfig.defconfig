## boards/shields/pedantric1/Kconfig.defconfig
```kconfig
if SHIELD_pedantric1_LEFT

config ZMK_KEYBOARD_NAME
    default "Pedantric1"

config ZMK_SPLIT_ROLE_CENTRAL
    default y

endif # SHIELD_pedantric1_LEFT

if SHIELD_pedantric1_LEFT || SHIELD_pedantric1_RIGHT

config ZMK_SPLIT
    default y

endif # SHIELD_pedantric1_LEFT || SHIELD_pedantric1_RIGHT
```

## boards/shields/pedantric1/Kconfig.shield
```kconfig
config SHIELD_pedantric1_LEFT
    def_bool $(shields_list_contains,pedantric1_left)

config SHIELD_pedantric1_RIGHT
    def_bool $(shields_list_contains,pedantric1_right)

config SHIELD_pedantric1_DONGLE
    def_bool $(shields_list_contains,pedantric1_dongle)
```

## config/west.yml
```yaml
manifest:
  remotes:
    - name: zmkfirmware
      url-base: https://github.com/zmkfirmware
    - name: rianadon
      url-base: https://github.com/rianadon
    - name: carrefinho
      url-base: https://github.com/carrefinho 
  projects:
    - name: zmk
      remote: rianadon
      revision: main
      import: app/west.yml
    - name: prospector-zmk-module
      remote: carrefinho 
      revision: main  
  self:
    path: config
    import: deps.yml
```
